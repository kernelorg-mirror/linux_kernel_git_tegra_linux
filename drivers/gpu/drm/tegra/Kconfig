## drivers/gpu/drm/tegra/Kconfig
```kconfig
config DRM_TEGRA
	tristate "NVIDIA Tegra DRM"
	depends on ARCH_TEGRA || (ARM && COMPILE_TEST)
	depends on COMMON_CLK
	depends on DRM
	depends on RESET_CONTROLLER
	select DRM_KMS_HELPER
	select DRM_MIPI_DSI
	select DRM_PANEL
	select DRM_SCDC
	select TEGRA_HOST1X
	help
	  Choose this option if you have an NVIDIA Tegra SoC.

	  To compile this driver as a module, choose M here: the module
	  will be called tegra-drm.

if DRM_TEGRA

config DRM_TEGRA_DEBUG
	bool "NVIDIA Tegra DRM debug support"
	help
	  This option enables debugging support for the Tegra DRM driver. It
	  causes the DEBUG macro to be defined and hence enables most of the
	  driver's debugging messages.

config DRM_TEGRA_STAGING
	bool "Enable HOST1X interface"
	depends on STAGING
	help
	  The Tegra DRM driver implements various userspace interfaces that
	  are considered experimental and unstable. They provide the means to
	  submit command streams, create and manipulate buffer objects and so
	  on.

	  Say Y here if these interfaces should be available to userspace DRM
	  users.

	  If unsure, choose N.

endif
```
